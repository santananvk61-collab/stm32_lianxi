/*
 * ssd1306.c —— SSD1306 OLED 驱动实现
 *
 * 核心思想（很重要，先理解这个）：
 *   OLED 屏幕有 128×64 = 8192 个像素点，但它不是一个个点单独控制的，
 *   而是按 "页(Page)" 组织：每 8 行像素压缩成 1 个字节（1 bit = 1 个像素）。
 *   所以整屏需要 128 × (64/8) = 1024 字节的 "显存(framebuffer)"。
 *
 *   我们所有画图操作都只改这 1024 字节（内存里），改完调一次
 *   SSD1306_UpdateScreen() 把 1024 字节通过 I2C 一次性发给 OLED。
 *   这样效率最高，也最容易理解。
 */
#include "ssd1306.h"

/* 显存：1024 字节，存在 RAM 里。初始全 0 = 全黑 */
static uint8_t SSD1306_Buffer[SSD1306_BUF_SIZE];

/* 字符光标（下一个字符画在哪里），单位是像素 */
static uint8_t CursorX = 0;
static uint8_t CursorY = 0;

/* ---------------- 字库：5×7 点阵 ASCII（空格 0x20 ~ 波浪号 0x7E） ----------------
 * 每个字符用 5 个字节表示，1 字节 = 1 列；字节最低位(bit0) = 该列最上面一行。
 * 这是嵌入式圈子里最常用的标准 5x7 字库，直接照抄即可。 */
static const uint8_t Font5x7[][5] = {
    {0x00,0x00,0x00,0x00,0x00}, // (space)
    {0x00,0x00,0x5F,0x00,0x00}, // !
    {0x00,0x07,0x00,0x07,0x00}, // "
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    {0x08,0x08,0x2A,0x1C,0x08}, // ~
};

/* ---------------- 底层 I2C 发送 ----------------
 * 通过 HAL 的 "存储器写" 函数发数据：它发的格式正好是
 * [从机地址][控制字节][数据...]，刚好符合 SSD1306 的协议。 */
static void SSD1306_WriteI2C(uint8_t ctrl, uint8_t *data, uint16_t size)
{
    HAL_I2C_Mem_Write(&hi2c1, SSD1306_I2C_ADDR, ctrl, 1, data, size, 100);
}

static void SSD1306_WriteCmd(uint8_t cmd)
{
    SSD1306_WriteI2C(SSD1306_CMD, &cmd, 1);
}

/* ---------------- 初始化 OLED ----------------
 * 一连串命令是 SSD1306 数据手册规定的上电初始化序列，
 * 不同 0.96 寸模块基本通用。看不懂每条命令没关系，照发即可。 */
void SSD1306_Init(void)
{
    uint8_t init_cmds[] = {
        0xAE,             // 关闭显示
        0xD5, 0x80,       // 设置时钟分频
        0xD3, 0x00,       // 显示偏移 0
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        0xA4,             // 显示内容跟随显存
        0xA6              // 正常显示（非反色）
    };
    for (uint8_t i = 0; i < sizeof(init_cmds); i++)
    {
        SSD1306_WriteCmd(init_cmds[i]);
    }

    /* 根据屏幕高度自动发 multiplex ratio 和 COM pins 配置
     * 128×64 屏：0xA8 0x3F / 0xDA 0x12
     * 128×32 屏：0xA8 0x1F / 0xDA 0x02   */
    if (SSD1306_HEIGHT == 64)
    {
        SSD1306_WriteCmd(0xA8); SSD1306_WriteCmd(0x3F);  // 64 行
        SSD1306_WriteCmd(0xDA); SSD1306_WriteCmd(0x12);  // COM pins：128×64 用 alternative(0x12)
    }
    else
    {
        SSD1306_WriteCmd(0xA8); SSD1306_WriteCmd(0x1F);  // 32 行
        SSD1306_WriteCmd(0xDA); SSD1306_WriteCmd(0x02);  // COM pins：128×32 用 sequential(0x02)
    }

    SSD1306_Clear();
    SSD1306_UpdateScreen();

    SSD1306_WriteCmd(0xAF);  // 打开显示（所有配置完成后再开，避免瞬间花屏）
}

/* 清屏：把显存全部写 0，再刷到屏幕 */
void SSD1306_Clear(void)
{
    for (uint16_t i = 0; i < SSD1306_BUF_SIZE; i++)
        SSD1306_Buffer[i] = 0x00;
}

/* 把整块显存(1024 字节)通过 I2C 发给 OLED */
void SSD1306_UpdateScreen(void)
{
    /* 先告诉 OLED：接下来要写的位置从 第0列 第0页 开始 */
    SSD1306_WriteCmd(0x21);  // 设置列地址命令
    SSD1306_WriteCmd(0);     // 起始列
    SSD1306_WriteCmd(127);   // 结束列
    SSD1306_WriteCmd(0x22);  // 设置页地址命令
    SSD1306_WriteCmd(0);     // 起始页
    SSD1306_WriteCmd((SSD1306_HEIGHT / 8) - 1);  // 结束页（64高=7，32高=3）
    /* 再一次性把 1024 字节显存当 "数据" 发出去 */
    SSD1306_WriteI2C(SSD1306_DATA, SSD1306_Buffer, SSD1306_BUF_SIZE);
}

/* 设置字符光标（像素坐标） */
void SSD1306_SetCursor(uint8_t x, uint8_t y)
{
    CursorX = x;
    CursorY = y;
}

/* 画一个像素点：on=1 点亮，on=0 熄灭。
 * 显存里第 (y/8) 页的第 x 列字节，对应 y 所在的那一位。 */
void SSD1306_DrawPixel(uint8_t x, uint8_t y, uint8_t on)
{
    if (x >= SSD1306_WIDTH || y >= SSD1306_HEIGHT) return;  // 超出屏幕忽略
    if (on)
        SSD1306_Buffer[x + (y / 8) * SSD1306_WIDTH] |=  (1 << (y % 8));
    else
        SSD1306_Buffer[x + (y / 8) * SSD1306_WIDTH] &= ~(1 << (y % 8));
}

/* 写一个字符（5×7 点阵，占 6 像素宽，方便字间距） */
void SSD1306_WriteChar(char ch)
{
    /* 小写字母映射成大写，字库里只有大写 */
    if (ch >= 'a' && ch <= 'z') ch -= 32;
    /* 只处理空格到波浪号，其它字符当空格处理 */
    if (ch < 0x20 || ch > 0x7E) ch = 0x20;

    const uint8_t *glyph = Font5x7[ch - 0x20];
    for (uint8_t col = 0; col < 5; col++)        // 5 列
    {
        for (uint8_t row = 0; row < 7; row++)    // 7 行
        {
            /* 该列字节的最低位(bit0) 是这一列最上面一行 */
            if (glyph[col] & (1 << row))
                SSD1306_DrawPixel(CursorX + col, CursorY + row, 1);
        }
    }
    CursorX += 6;  // 字符宽度 5 + 1 间距
    /* 写到右边界就换行 */
    if (CursorX > SSD1306_WIDTH - 6)
    {
        CursorX = 0;
        CursorY += 8;
    }
}

/* 写字符串 */
void SSD1306_WriteString(const char *str)
{
    while (*str)
    {
        SSD1306_WriteChar(*str);
        str++;
    }
}

/* 写整数（自己转成字符，不依赖 printf 库） */
void SSD1306_WriteInt(int val)
{
    char buf[6];
    int i = 0;
    if (val < 0)
    {
        SSD1306_WriteChar('-');
        val = -val;
    }
    if (val == 0)
        buf[i++] = '0';
    while (val > 0)
    {
        buf[i++] = (char)('0' + (val % 10));
        val /= 10;
    }
    /* 刚才是从个位往上存的，需要倒过来（反转） */
    for (int j = 0; j < i / 2; j++)
    {
        char t = buf[j];
        buf[j] = buf[i - 1 - j];
        buf[i - 1 - j] = t;
    }
    buf[i] = '\0';
    SSD1306_WriteString(buf);
}
